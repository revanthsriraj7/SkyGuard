#include <SPI.h>
#include <LoRa.h>
#include <Wire.h>
#include <BluetoothSerial.h>
#include <Wire.h>
#include <Adafruit_GFX.h>
#include <Adafruit_SSD1306.h>

BluetoothSerial serialBT;

#define ss 5
#define rst 14
#define dio0 2

#define SCREEN_WIDTH 128 // OLED display width, in pixels
#define SCREEN_HEIGHT 64 // OLED display height, in pixels

String received;
String data1;
String data2;

Adafruit_SSD1306 display(SCREEN_WIDTH, SCREEN_HEIGHT, &Wire, -1);

void setup() 
{
  Serial.begin(9600);
  serialBT.begin("SkyGuard");
  pinMode(4, OUTPUT);
  
  LoRa.setPins(ss, rst, dio0);

    if(!display.begin(SSD1306_SWITCHCAPVCC, 0x3C))
    { 
    Serial.println("SSD1306 allocation failed");
    for(;;);
    } 
  display.clearDisplay();
  display.setTextSize(1);             
  display.setTextColor(WHITE);        
  display.setCursor(0,20);             
  display.println("OLED Check");
  display.display();
  delay(500);   
  
  if (!LoRa.begin(433E6)) 
  {
    Serial.println("LoRa initialization failed!");
    while (1);
  }
  Serial.println("LoRa initialized");
  display.clearDisplay();
  display.setTextSize(1);             
  display.setTextColor(WHITE);        
  display.setCursor(0,20);             
  display.println("LORA Check");
  display.display();
  delay(500);
  
  SkyGuard();
  delay(1000);
  
}

void loop() 
{
  // Check for Bluetooth commands
if (serialBT.available()) {
    String command = serialBT.readString(); // Read the full string
    command.trim(); // Remove extra spaces or newline characters
    
    if (command == "up")
    {
      LoRa.beginPacket();
      LoRa.print("up");
      LoRa.endPacket();
      Serial.println("Camera Up");
      Cameraup();
      Finding();
    } 
    else if (command == "down")
    {
      Cameradown();
      LoRa.beginPacket();
      LoRa.print("down");
      LoRa.endPacket();
      Serial.println("Camera Down");
      Cameradown();
      Finding();
    } 

    
    else if (command == "hold")
    {
      LoRa.beginPacket();
      LoRa.print("hold");
      LoRa.endPacket();
      Serial.println("Gripper lock");
      GripperLock();
      Finding();
    } 
    else if (command == "leave") 
    {
      LoRa.beginPacket();
      LoRa.print("leave");
      LoRa.endPacket();
      Serial.println("gripper unlock");
      Gripperunlock(); 
      Finding();
    } 

    else if (command == "remove") 
    {
      LoRa.beginPacket();
      LoRa.print("remove");
      LoRa.endPacket();
      Serial.println("Mechsphere leave");
      Mechunlock();
      Finding();
    } 

    else if (command == "attach") 
    {
      LoRa.beginPacket();
      LoRa.print("attach");
      LoRa.endPacket();
      Serial.println("Mechsphere lock");
      Mechlock();
      Finding();
    } 

    else
    {
      Finding();
    } 
  }

  // Receive data from LoRa
  int packetSize = LoRa.parsePacket();
  if (packetSize) 
  {
    Planet();
    received = LoRa.readString();
    digitalWrite(4, HIGH);
    delay(500);
    digitalWrite(4, LOW);
    delay(500);
   

    int splitIndex = received.indexOf(','); // Assume longitude and latitude are separated by a comma
    if (splitIndex != -1)
    {
      data1 = received.substring(0, splitIndex);  // Longitude
      data2 = received.substring(splitIndex + 1); // Latitude
    }

    // Send received data back via Bluetooth
    serialBT.print(data1);  
    serialBT.print("|");
    serialBT.println(data2); 
    serialBT.print("|");
    
    display.clearDisplay();
    display.setTextSize(1);             
    display.setTextColor(WHITE);        
    display.setCursor(0,0);             
    display.print("LATIUDE:");
    
    display.setTextSize(2);
    display.setCursor(0,10);
    display.println(data1);

    display.setTextSize(1);
    display.setCursor(0,40);
    display.print("LONGITUDE:");

    display.setTextSize(2);
    display.setCursor(0,50);
    display.println(data2);
    display.display();
    delay(500);
    
  }
}


void Planet()
{
 display.clearDisplay();
 const unsigned char bitplanet [] PROGMEM = {
 0x00, 0x00, 0x00, 0x00, 0x00, 0x00, 0x00, 0x00, 0x00, 0x00, 0x00, 0x00, 0x00, 0x00, 0x00, 0x00, 
  0x00, 0x00, 0x00, 0x00, 0x00, 0x00, 0x00, 0x00, 0x00, 0x00, 0x00, 0x00, 0x00, 0x00, 0x00, 0x00, 
  0x00, 0x00, 0x00, 0x00, 0x00, 0x00, 0x00, 0x00, 0x00, 0x00, 0x00, 0x00, 0x00, 0x00, 0x00, 0x00, 
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  0x00, 0x00, 0x00, 0x00, 0x00, 0x00, 0x00, 0x00, 0x00, 0x00, 0x00, 0x00, 0x00, 0x00, 0x00, 0x00
};

  display.clearDisplay();
  display.drawBitmap(0, 0, bitplanet, 128, 64, WHITE);
  display.display();
  delay(500);
}


void SkyGuard()
{
 display.clearDisplay();
const unsigned char logosky [] PROGMEM = {
  0x00, 0x00, 0x00, 0x00, 0x00, 0x00, 0x00, 0x00, 0x00, 0x00, 0x00, 0x00, 0x00, 0x00, 0x00, 0x00, 
  0x00, 0x00, 0x00, 0x00, 0x00, 0x00, 0x00, 0x00, 0x00, 0x00, 0x00, 0x00, 0x00, 0x00, 0x00, 0x00, 
  0x00, 0x00, 0x00, 0x00, 0x00, 0x00, 0x00, 0x00, 0x00, 0x00, 0x00, 0x00, 0x00, 0x00, 0x00, 0x00, 
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  0x00, 0x00, 0x00, 0x00, 0x00, 0x00, 0x00, 0x00, 0x00, 0x00, 0x00, 0x00, 0x00, 0x00, 0x00, 0x00
};

  display.clearDisplay();
  display.drawBitmap(2, 0, logosky, 128, 64, WHITE);
  display.display();
  delay(1000);
}


void Cameraup()
{
 display.clearDisplay();
 const unsigned char logoCamera_up [] PROGMEM = {
 0x00, 0x00, 0x00, 0x00, 0x00, 0x00, 0x00, 0x00, 0x00, 0x00, 0x00, 0x00, 0x00, 0x00, 0x00, 0x00, 
  0x00, 0x00, 0x00, 0x00, 0x00, 0x00, 0x00, 0x00, 0x00, 0x00, 0x00, 0x00, 0x00, 0x00, 0x00, 0x00, 
  0x00, 0x00, 0x00, 0x00, 0x00, 0x00, 0x00, 0x00, 0x00, 0x00, 0x00, 0x00, 0x00, 0x00, 0x00, 0x00, 
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  0x00, 0x00, 0x00, 0x00, 0x00, 0x00, 0x00, 0x00, 0x00, 0x00, 0x00, 0x00, 0x00, 0x00, 0x00, 0x00
};

  display.clearDisplay();
  display.drawBitmap(0, 0, logoCamera_up, 128, 64, WHITE);
  display.display();
  delay(500);
}


void Cameradown()
{
 display.clearDisplay();
 const unsigned char logoCamera_down [] PROGMEM = {
 0x00, 0x00, 0x00, 0x00, 0x00, 0x00, 0x00, 0x00, 0x00, 0x00, 0x00, 0x00, 0x00, 0x00, 0x00, 0x00, 
  0x00, 0x00, 0x00, 0x00, 0x00, 0x00, 0x00, 0x00, 0x00, 0x00, 0x00, 0x00, 0x00, 0x00, 0x00, 0x00, 
  0x00, 0x00, 0x00, 0x00, 0x00, 0x00, 0x00, 0x00, 0x00, 0x00, 0x00, 0x00, 0x00, 0x00, 0x00, 0x00, 
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  0x00, 0x00, 0x00, 0x00, 0x00, 0x00, 0x00, 0x00, 0x00, 0x00, 0x00, 0x00, 0x00, 0x00, 0x00, 0x00
};

  display.clearDisplay();
  display.drawBitmap(0, 0, logoCamera_down, 128, 64, WHITE);
  display.display();
  delay(500);
}



void GripperLock()
{
 display.clearDisplay();
const unsigned char logoimages [] PROGMEM = {
  0x00, 0x00, 0x00, 0x00, 0x00, 0x00, 0x00, 0x00, 0x00, 0x00, 0x00, 0x00, 0x00, 0x00, 0x00, 0x00, 
  0x00, 0x00, 0x00, 0x00, 0x00, 0x00, 0x00, 0x00, 0x00, 0x00, 0x00, 0x00, 0x00, 0x00, 0x00, 0x00, 
  0x00, 0x00, 0x00, 0x00, 0x00, 0x00, 0x00, 0x00, 0x00, 0x00, 0x00, 0x00, 0x00, 0x00, 0x00, 0x00, 
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  0x00, 0x00, 0x00, 0x00, 0x00, 0x00, 0x00, 0x00, 0x00, 0x00, 0x00, 0x00, 0x00, 0x00, 0x00, 0x00
};


  display.clearDisplay();
  display.drawBitmap(0, 0, logoimages, 128, 64, WHITE);
  display.display();
  delay(500);
}



void Gripperunlock()
{
 display.clearDisplay();
  const unsigned char logogripper_oFF [] PROGMEM = {
  0x00, 0x00, 0x00, 0x00, 0x00, 0x00, 0x00, 0x00, 0x00, 0x00, 0x00, 0x00, 0x00, 0x00, 0x00, 0x00, 
  0x00, 0x00, 0x00, 0x00, 0x00, 0x00, 0x00, 0x00, 0x00, 0x00, 0x00, 0x00, 0x00, 0x00, 0x00, 0x00, 
  0x00, 0x00, 0x00, 0x00, 0x00, 0x00, 0x00, 0x00, 0x00, 0x00, 0x00, 0x00, 0x00, 0x00, 0x00, 0x00, 
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  0x00, 0x00, 0x00, 0x00, 0x00, 0x00, 0x00, 0x00, 0x00, 0x00, 0x00, 0x00, 0x00, 0x00, 0x00, 0x00
};

  display.clearDisplay();
  display.drawBitmap(0, 0, logogripper_oFF, 128, 64, WHITE);
  display.display();
  delay(500);
}



void Mechlock()
{
 display.clearDisplay();
  const unsigned char Logolock [] PROGMEM = {
  0x00, 0x00, 0x00, 0x00, 0x00, 0x00, 0x00, 0x00, 0x00, 0x00, 0x00, 0x00, 0x00, 0x00, 0x00, 0x00, 
  0x00, 0x00, 0x00, 0x00, 0x00, 0x00, 0x00, 0x00, 0x00, 0x00, 0x00, 0x00, 0x00, 0x00, 0x00, 0x00, 
  0x00, 0x00, 0x00, 0x00, 0x00, 0x00, 0x00, 0x00, 0x00, 0x00, 0x00, 0x00, 0x00, 0x00, 0x00, 0x00, 
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  0x00, 0x00, 0x00, 0x00, 0x00, 0x00, 0x00, 0x00, 0x00, 0x00, 0x00, 0x00, 0x00, 0x00, 0x00, 0x00
};

  display.clearDisplay();
  display.drawBitmap(0, 0, Logolock, 128, 64, WHITE);
  display.display();
  delay(500);
}


void Mechunlock()
{
 display.clearDisplay();
  const unsigned char logounlock [] PROGMEM = {
  0x00, 0x00, 0x00, 0x00, 0x00, 0x00, 0x00, 0x00, 0x00, 0x00, 0x00, 0x00, 0x00, 0x00, 0x00, 0x00, 
  0x00, 0x00, 0x00, 0x00, 0x00, 0x00, 0x00, 0x00, 0x00, 0x00, 0x00, 0x00, 0x00, 0x00, 0x00, 0x00, 
  0x00, 0x00, 0x00, 0x00, 0x00, 0x00, 0x00, 0x00, 0x00, 0x00, 0x00, 0x00, 0x00, 0x00, 0x00, 0x00, 
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  0x00, 0x00, 0x00, 0x00, 0x00, 0x00, 0x00, 0x00, 0x00, 0x00, 0x00, 0x00, 0x00, 0x00, 0x00, 0x00
};

  display.clearDisplay();
  display.drawBitmap(0, 0, logounlock, 128, 64, WHITE);
  display.display();
  delay(500);
}


void Finding()
{
 display.clearDisplay();
 const unsigned char lolIDEL [] PROGMEM = {
 0xff, 0xff, 0xff, 0x00, 0x00, 0x00, 0x00, 0x00, 0x00, 0x00, 0x00, 0x00, 0x00, 0x00, 0x03, 0xff, 
  0xff, 0xff, 0xff, 0x00, 0x00, 0x00, 0x00, 0x00, 0x00, 0x00, 0x00, 0x00, 0x00, 0x00, 0x03, 0xff, 
  0xff, 0xff, 0xff, 0x00, 0x00, 0x00, 0x00, 0x00, 0x00, 0x00, 0x00, 0x00, 0x00, 0x00, 0x03, 0xff, 
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  0xff, 0xff, 0xff, 0xf8, 0x00, 0x00, 0x00, 0x00, 0x00, 0x00, 0x00, 0x00, 0x00, 0x00, 0x1f, 0xff
};

  display.clearDisplay();
  display.drawBitmap(0, 0, lolIDEL, 128, 64, WHITE);
  display.display();
  delay(10);
}
